## drivers/media/video/samsung/Kconfig.rej
```kconfig
--- drivers/media/video/samsung/Kconfig
+++ drivers/media/video/samsung/Kconfig
@@ -17,6 +17,8 @@ if CPU_EXYNOS4210 || CPU_EXYNOS4212 || CPU_EXYNOS4412
 	source "drivers/media/video/samsung/fimc/Kconfig"
 	source "drivers/media/video/samsung/tvout/Kconfig"
 	source "drivers/media/video/samsung/mfc5x/Kconfig"
+	source "drivers/media/video/samsung/mali/Kconfig"
+	source "drivers/media/video/samsung/ump/Kconfig"
 endif
 
 config VIDEO_FIMG2D
```
